## conf/layer.conf
```bitbake
# LAYER.conf

# Use in BBLAYERS.CONF following poky/meta and poky/meta-poky
# such that the prepend places this layer at the front of BBPATH

BBPATH =. "${LAYERDIR}:"

BBFILES += "${LAYERDIR}/recipes-*/*/*.bb ${LAYERDIR}/recipes-*/*/*.bbappend"

BBFILE_COLLECTIONS += "distro-distro-com-cexpress-bt"
BBFILE_PATTERN_distro-distro-com-cexpress-bt = "^${LAYERDIR}/"
BBFILE_PRIORITY_distro-distro-com-cexpress-bt = "12"

# Requied dependency layers that are present in every build
LAYERDEPENDS_distro-distro-com-cexpress-bt = "distro-core"
LAYERSERIES_COMPAT_distro-distro-com-cexpress-bt = "kirkstone scarthgap"
```
